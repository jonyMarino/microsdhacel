        /** ###################################################################
**     THIS BEAN MODULE IS GENERATED BY THE TOOL. DO NOT MODIFY IT.
**     Filename  : TO1.C
**     Project   : _10_03
**     Processor : MC9S12GC32CFU16
**     Beantype  : TimerOut
**     Version   : Bean 02.095, Driver 01.08, CPU db: 2.87.320
**     Compiler  : Metrowerks HC12 C Compiler
**     Date/Time : 19/07/2006, 10:03 a.m.
**     Abstract  :
**         This bean implements a periodic signal generator 1:1 (Flip-Flop Output).
**         The signal alternates the "0" and "1" output values in exactly
**         regular intervals; that is why the time length of the "0" part
**         of one pulse is equal to the "1" part of one pulse.
**     Settings  :
**         Used output pin             : 
**             ----------------------------------------------------
**                Number (on package)  |    Name
**             ----------------------------------------------------
**                       6             |  PT1_PWM1_IOC1
**             ----------------------------------------------------
**
**         Timer name                  : TIM (16-bit)
**         Compare name                : TC1
**           Counter shared            : No
**
**         High speed mode
**             Prescaler               : divide-by-4
**             Clock                   : 6250000 Hz
**           Pulse width
**             Xtal ticks              : 32
**             microseconds            : 4
**             seconds (real)          : 0.0000040
**             Hz                      : 250000
**             kHz                     : 250
**
**         Runtime setting             : pulse width interval (continual setting)
**             ticks                   : 32 to 80000 ticks
**             microseconds            : 4 to 10000 microseconds
**             milliseconds            : 1 to 10 milliseconds
**             seconds (real)          : 0.0000040 to 0.0100000 seconds
**             Hz                      : 100 to 250000 Hz
**             kHz                     : 1 to 250 kHz
**
**         Initialization:
**              Output level           : low
**              Timer                  : Enabled
**              Events                 : Enabled
**
**         Timer registers
**              Counter                : TCNT      [68]
**              Mode                   : TIOS      [64]
**              Run                    : TSCR1     [70]
**              Prescaler              : TSCR2     [77]
**
**         Compare registers
**              Compare                : TC1       [82]
**
**         Flip-flop registers
**              Mode                   : TCTL2     [73]
**     Contents  :
**         Enable      - byte TO1_Enable(void);
**         Disable     - byte TO1_Disable(void);
**         SetPeriodUS - byte TO1_SetPeriodUS(word Time);
**         SetValue    - byte TO1_SetValue(void);
**         ClrValue    - byte TO1_ClrValue(void);
**
**     (c) Copyright UNIS, spol. s r.o. 1997-2004
**     UNIS, spol. s r.o.
**     Jundrovska 33
**     624 00 Brno
**     Czech Republic
**     http      : www.processorexpert.com
**     mail      : info@processorexpert.com
** ###################################################################*/


/* MODULE PWM. */

#include "Events.h"
#include "PE_Error.h"
//#include "Mydefines.h"
#include "utils_pwm_timer.hpp"
#include "stdtypes.h"
#include "PWM.hpp"
#include "PWMTimer.hpp"


#pragma DATA_SEG PWM_DATA                                            
#pragma CODE_SEG PWM_CODE  
#pragma CONST_SEG DEFAULT

#pragma MESSAGE DISABLE C2705                   

#define PWM_NUM_SALIDAS 8


#define TICKS_1_SEG 500000

static const dword PeriodsTicks[PWM_MAX_VALUE_PERIODS+1]={ 
   TICKS_1_SEG/10, /* 100 ms*/
   TICKS_1_SEG/5,	 /* 200 ms*/
   TICKS_1_SEG/2,	 /* 500 ms*/
   TICKS_1_SEG,	   /*   1  s*/
   TICKS_1_SEG*2,	 /*   2  s*/
   TICKS_1_SEG*5,	 /*   5  s*/
   TICKS_1_SEG*10,	 /*  10  s*/
   TICKS_1_SEG*20,	 /*  20  s*/
   TICKS_1_SEG*50,	 /*  50  s*/
   TICKS_1_SEG/200   /* Anl(5ms) */
};
static const char * const strsPeriods[]={
  ".1  ",".2  ",".5  ","1   ","2   ","5   ","10  ","20  "
  ,"50  ","AnL "
};

static  PWMTimer * pwms[8];

//static bool EnUser[PWM_NUM_SALIDAS];      /* Enable/Disable device by user */

//static dword Period[PWM_NUM_SALIDAS],Duty[PWM_NUM_SALIDAS];

//#define DutyFree(num) Period[num] - Duty[num]


void PWM_init( PWMTimer * pwm,byte pin){
  pwms[pin]=pwm;
  TIOS |= 1<<pin;
  TTOV &= ~(1<<pin);
}

#pragma INLINE
void dis_timer_interrupt(byte timer){
  byte pos = 1<<timer;
  TIE &= ~pos;                       /* Disable interrupt */    
}

#pragma INLINE
void en_timer_interrupt(byte timer){
  byte pos = 1<<timer;
  TIE |= pos;                       /* Disable interrupt */    
}

/* Setea la variable del duty de forma segura mientras se esta 
en modo proporcional*/
void pwm_timer_set_periodo( PWMTimer * pwm,ulong periodo){
  uchar salida = pwm->pinNum;
  dis_timer_interrupt(salida);
  pwm->ticksPeriodo = periodo;
  en_timer_interrupt(salida);
}
/* Setea la variable del duty de forma segura mientras se esta 
en modo proporcional*/
void pwm_timer_set_duty( PWMTimer * pwm,ulong duty){
  uchar salida = pwm->pinNum;
  dis_timer_interrupt(salida);
  pwm->ticksDuty =  duty;
  en_timer_interrupt(salida);
}
/*
** ===================================================================
**     Method      :  TO1_SetPeriod (bean TimerOut)
**
**     Description :
**         This method sets the new period of the output signal. The
**         period is expressed in microseconds as a 16-bit unsigned
**         integer number.
**         This method is available only if the runtime setting type
**         'from interval' is selected in the Timing dialog box in
**         the Runtime setting area.
**     Parameters  :
**         NAME            - DESCRIPTION
**         Time            - Period to set [in microseconds]
**                      (4 to 10000 microseconds)
**     Returns     :
**         ---             - Error code, possible codes:
**                           ERR_OK - OK
**                           ERR_SPEED - This device does not work in
**                           the active speed mode
**                           ERR_MATH - Overflow during evaluation
**                           ERR_RANGE - Parameter out of range
** ===================================================================
*/
byte setPWM_period( PWMTimer * pwm,byte Mode)
{
  if (Mode>PWM_MAX_VALUE_PERIODS)
    return ERR_RANGE;
  if(pwm_timer_isEnable(pwm->pinNum))
    pwm_timer_set_periodo(pwm,PeriodsTicks[Mode]);
  else
    pwm->ticksPeriodo = PeriodsTicks[Mode];  
  

  return ERR_OK;                       /* OK */ 
}

bool pwm_timer_isEnable(uchar salida){
  return  TIE & 1<<salida; 
}

byte PWM_SetRatio16( PWMTimer * pwm,word Ratio)		/*Ratio es un valor de 0 a 1000*/
{
  ulong duty;
  ulong periodo =pwm->ticksPeriodo;
  uchar salida = pwm->pinNum;
  
  if (Ratio >1000 || salida>PWM_NUM_SALIDAS)    /* Is the given value out of range? */
    return ERR_RANGE;                  /* If yes then error */
  
  if(pwm_timer_isEnable(salida)){
    if (Ratio==1000)
      duty = periodo;
    else if(Ratio==0)
      duty = 0;
    else if (periodo<4000000)		 /*Verifico los valores para decidir que operacion hacer debido a los limites de un long*/
      duty = (periodo*Ratio)/1000;
    else
      duty = (periodo/1000)*Ratio;
    
    if(duty<30){//15 es el minimo tiempo para asegurar la corrida de la interrupcion  
      if(duty<15) 
        duty=0;
      else 
        duty=30;  
    } 
    else{
      long dutyfree=periodo-duty;
      
      if (dutyfree<30){
        if(dutyfree<15) 
          duty=periodo;
        else 
          duty=periodo-30;      
      }
    }
    pwm_timer_set_duty(pwm,duty);
  
  }else{
     if(Ratio==0){
      pwm->ticksDuty =0;
  	  PWM_ClrValue(salida);
     }else{
      pwm->ticksDuty =1000;	
      Ratio=1000;
  	  PWM_SetValue(salida);  
     }
  }
  return ERR_OK;                       /* OK */
}

/*
** ===================================================================
**     Method      :  PWM_getPeriodText
**
**     Description :
** ===================================================================
*/
const char * PWM_getPeriodText(byte period){
  return strsPeriods[period];
}
/*
** ===================================================================
**     Method      :  HWEnDi (bean TimerOut)
**
**     Description :
**         This method is internal. It is used by Processor Expert
**         only.
** ===================================================================
*/
static void HWEnDi(byte num_salida)
{  byte pos,num_pwm;
  
  num_pwm= num_salida;
  pos = 1<<num_pwm;
  if (!pwm_timer_isEnable(num_salida)) {                        /* Enable device? */
    TFLG1 |= pos;                     /* Reset request flag */
    TIE |= pos;                       /* Enable interrupt */
    if(num_pwm<4){
      TCTL2 |= 1<<((num_pwm)*2+1);		   //OM
      TCTL2 |= 1<<(num_pwm*2);           /* Connect timer to output pin */
    }else{
      TCTL1 |= 1<<((num_pwm-4)*2+1);		 //OM
      TCTL1 |= 1<<((num_pwm-4)*2);
    }
  }
  else {                                 /* Disable device? */
    TIE &= ~pos;                       /* Disable interrupt */
    if(num_pwm<4){     
      TCTL2 &= ~(1<<((num_pwm*2)+1));        /* Connect timer to output pin */
      TCTL2 &= ~(1<<(num_pwm*2));        /* Connect timer to output pin */
    }else {      
      TCTL1 &= ~(1<<(((num_pwm-4)*2)+1));
      TCTL1 &= ~(1<<((num_pwm-4)*2));
    }
  
  }
}


/*
** ===================================================================
**     Method      :  TO1_Enable (bean TimerOut)
**
**     Description :
**         Enables the bean - it starts the signal generation. Events
**         may be generated ("DisableEvent"/"EnableEvent").
**     Parameters  : None
**     Returns     : None
** ===================================================================
*/
void PWM_Enable(byte num_salida)
{
  if (!pwm_timer_isEnable(num_salida)) {                       /* Is the device disabled by user? */
    HWEnDi(num_salida);                          /* Disable the device */
  }
}

/*
** ===================================================================
**     Method      :  TO1_Disable (bean TimerOut)
**
**     Description :
**         Disables the timer - it stops signal generation and events
**         calling. When the timer is disabled, it is possible to
**         call methods "ClrValue" and "SetValue".
**     Parameters  : None
**     Returns     : None
** ===================================================================
*/
void PWM_Disable(byte num_salida)
{
  if (pwm_timer_isEnable(num_salida)) {                        /* Is the device enabled by user? */
    HWEnDi(num_salida);                          /* Disable the device */
  }
}

/*
** ===================================================================
**     Method      :  PWM_SetValue (bean TimerOut)
**
**     Description :
**         This method sets (sets to "1" = "High") timer flip-flop
**         output signal level. It allow user to directly set the
**         output pin value (=flip-flop state), and can set the
**         signal polarity. This method works only when the timer is
**         disabled (Disable) otherwise it returns the error code.
**     Parameters  : None
**     Returns     : None
** ===================================================================
*/
void PWM_SetValue(byte num_salida)
{
  
  PTT |= 1<<num_salida;                        /* Set output signal level to high */
}


/*
** ===================================================================
**     Method      :  PWM_ClrValue (bean TimerOut)
**
**     Description :
**         This method clears (sets to "0" = "Low") timer flip-flop
**         output signal level. It allow user to directly set the
**         output pin value (=flip-flop state), and can set the
**         signal polarity. This method works only when the timer is
**         disabled (Disable) otherwise it returns the error code.
**     Parameters  : None
**     Returns     : None
** ===================================================================
*/
void PWM_ClrValue(byte num_salida)
{
  PTT &= ~(1<<num_salida);                        /* Set output signal level to high */
}

/*
** ===================================================================
**     Method      :  Conf_Toggle (bean TimerOut)
**
**     Description :
**         This method is internal. Permite Elegir cual será el proximo 
**  estado al interrumpir
** ===================================================================
*/
void PutVal (bool Value,byte salida){
  if(salida<4){
    if(Value)
      TCTL2|= 1<<(salida*2);
    else
      TCTL2&= ~(1<<(salida*2));
  } else{
    int relativo = salida-4;
    if(Value)
      TCTL1|= 1<<(relativo*2);
    else
      TCTL1&= ~(1<<(relativo*2));    
  }
}
/*
** ===================================================================
**     Method      :  Conf_Toggle (bean TimerOut)
**
**     Description :
**         This method is internal. It is used by Processor Expert
**         only.
** ===================================================================
*/
dword Conf_Toggle( PWMTimer * pwm,bool * next_Value)
{
if ((* next_Value &&  pwm->ticksDuty!=pwm->ticksPeriodo) || pwm->ticksDuty==0){
    PutVal (0,pwm->pinNum);  /* Poner la salida en bajo al interrumpir */                   
    pwm->estadoSalida=FALSE;
    * next_Value=0;
    return pwm->ticksDutyFree; 
  }else{
    PutVal(1,pwm->pinNum);  /* Poner la salida en alto al interrumpir */                   
    pwm->estadoSalida=TRUE;
    * next_Value=1;
    pwm->ticksDutyFree =  pwm->ticksPeriodo - pwm->ticksDuty;
    return pwm->ticksDuty;
  }
}

/*
** ===================================================================
**     Method      :  TO1_Interrupt (bean TimerOut)
**
**     Description :
**         This method is internal. It is used by Processor Expert
**         only.
** ===================================================================
*/
#define PWM_INTERRUPT(n)    \
ISR(PWM##n##_Interrupt){\
  static long ciclo=65535;   \
  static bool internalValue=0,previousValue=1;  \
  if (ciclo>65535){					\
    TC##n += 65500;				  \
 		ciclo-=65500;						\
  }else{										\
    TC##n += ciclo;					\
    ciclo=0;								\
  }												  \
    if (internalValue!=previousValue){/*¿Hubo un cambio de estado en esta interrupcion???*/  \
 		  previousValue=internalValue;\
 		  llama_callOnToggleListeners(n);\
  }																			 \
  if(ciclo==0)													 \
    ciclo=Conf_Toggle(pwms[n],&internalValue); \
  TFLG1 = 1<<n;             \
}


#pragma CODE_SEG __NEAR_SEG NON_BANKED   

PWM_INTERRUPT(0)
//PWM_INTERRUPT(1)
ISR(PWM1_Interrupt)
{  
  static long Ciclo=65535;
  static bool Internal_Value=0,Previous_Value=1;
  
  if (Ciclo>65535){
    TC1 += 65500;
 		Ciclo-=65500;
  }else{
    TC1 += Ciclo;
    Ciclo=0;
  }
  
  if (Internal_Value!=Previous_Value){  /* Hubo un cambio de estado en esta interrupcion???*/
 		  Previous_Value=Internal_Value;
 		 
 		 llama_callOnToggleListeners(1);
  }
  
  if(Ciclo==0)
    Ciclo=Conf_Toggle(pwms[1],&Internal_Value);  
  
  TFLG1 = 2;          /* Reset interrupt request flag */
}


#pragma INLINE

void llama_callOnToggleListeners(char n){
   pwms[n]->callOnToggleListeners();
}


PWM_INTERRUPT(2)
PWM_INTERRUPT(3)
PWM_INTERRUPT(4)
PWM_INTERRUPT(5)
PWM_INTERRUPT(6)


#ifndef SALIDA7_PUERTO_P
PWM_INTERRUPT(7)
#else
ISR(PWM7_Interrupt)
{  
  static long Ciclo=65535;
  static bool Internal_Value=0,Previous_Value=1;
  
  if (Ciclo>65535){
    TC7 += 65500;
 		Ciclo-=65500;
  }else{
    TC7 += Ciclo;
    Ciclo=0;
  }
  
  if (Internal_Value!=Previous_Value){  /* Hubo un cambio de estado en esta interrupcion???*/
 		  Previous_Value=Internal_Value;
 		 
 		 if(getReg8(PTIT)&128)    //bit 7 del puerto T es 1?
 		  setReg8Bits(PTP,128);   //seteo el bit 6 del puerto P
 		 else
 		  clrReg8Bits(PTP,128);   //reseteo el bit 6 del puerto P
 		 
 		 llama_callOnToggleListeners(7);
  }
  
  if(Ciclo==0)
    Ciclo=Conf_Toggle(pwms[7],&Internal_Value);  
  
  TFLG1 = 1<<7;          /* Reset interrupt request flag */
}

#endif
#pragma CODE_SEG PWM_CODE                     

/* END TO1. */

/*
** ###################################################################
**
**     This file was created by UNIS Processor Expert 2.95 [03.62]
**     for the Freescale HCS12 series of microcontrollers.
**
** ###################################################################
*/
