/** ###################################################################
**     THIS BEAN MODULE IS GENERATED BY THE TOOL. DO NOT MODIFY IT.
**     Filename  : IFsh10.C
**     Project   : _2_11_b
**     Processor : MC9S12GC32CFU16
**     Beantype  : IntFLASH
**     Version   : Bean 02.164, Driver 02.08, CPU db: 2.87.320
**     Compiler  : Metrowerks HC12 C Compiler
**     Date/Time : 02/12/2005, 16:20
**     Abstract  :
**         This bean "IntFLASH" implements an access to internal FLASH.
**         The bean support reading/writing data into FLASH, erasing of 
**         selected sector.
**         The bean supports events if the write interrupt is supported.
**         The bean supports following modes of write operations:
**           - Write - writing without any test.
**           - Destructive write - sector is erased if necessary.
**           - Safe write - user event is invoked to save and resore data
**                          from the current sector.
**         The bean requires on-chip FLASH memory (not used/allocated by 
**         other beans).
**     Settings  :
**         Total FLASH memory size       : 32KB
**         Interrupt service             : Disabled
**         Write method                  : Safe write (with save & erase)
**         Buffer Type                   : Implemented by the bean
**         Wait in RAM                   : yes
**     Contents  :
**         SetWordFlash - byte IFsh10_SetWordFlash(dword Addr,word Data);
**
**     (c) Copyright UNIS, spol. s r.o. 1997-2004
**     UNIS, spol. s r.o.
**     Jundrovska 33
**     624 00 Brno
**     Czech Republic
**     http      : www.processorexpert.com
**     mail      : info@processorexpert.com
** ###################################################################*/


/* MODULE IFsh10. */

#include "IFsh10.h"
#include "Mydefines.h"

#pragma DATA_SEG IFsh10_DATA                                            
#pragma CODE_SEG IFsh10_CODE                     

/* Global variables */
extern int PRam[Parametros+1];          /* Array for backup data */    /* Array for backup data from erased sector */
static byte WaitInRAMcode[]={
 0x1E, 0x01, 0x05, 0x20, 0x05,         /* BRSET _FSTAT,#32,*+10 */
 0x1F, 0x01, 0x05, 0x10, 0x03,         /* BRCLR _FSTAT,#16,*+8 */
 0xC6, 0x09,                           /* LDAB  #9 */
 0x3D,                                 /* RTS */
 0x1F, 0x01, 0x05, 0x40, 0xFB,         /* BRCLR _FSTAT,#64,*+0 */
 0x3D                                  /* RTS */
};

/*
** ===================================================================
**     Method      :  ClearFlags (bean IntFLASH)
**
**     Description :
**         This method is internal. It is used by Processor Expert
**         only.
** ===================================================================
*/
static void ClearFlags(void)
{
  FSTAT = 48;                          /* Clear PVIOL & ACERR flag */
}



/*
** ===================================================================
**     Method      :  WriteWord (bean IntFLASH)
**
**     Description :
**         This method is internal. It is used by Processor Expert
**         only.
** ===================================================================
*/
byte WriteWord(dword Addr,word Data16)
{
  byte err;

  EnterCritical();                     /* Enter critical section */
  ClearFlags();                        /* Clear all flags */
   if (FSTAT_CBEIF == 0) {              /* Is command buffer full ? */
    ExitCritical();                    /* Exit critical section */
    return ERR_BUSY;                   /* If yes then error */
  }
  *(volatile word *) Addr = Data16;    /* Array address and program data */
  FCMD = 32;                           /* Word program command */
  FSTAT = 128;                         /* Clear flag command buffer empty */
  asm {                                /* Jump to Wait in RAM code */
    CLRB
    JSR WaitInRAMcode
    STAB err
  }
  ExitCritical();                      /* Exit critical section */
  if (err)
    return ERR_NOTAVAIL;               /* Return error code if previous operation finished not correctly */
  if (*(volatile word *) Addr != Data16) /* Was attempt to write data to the given address errorneous? */
    return ERR_VALUE;                  /* If yes then error */
 return ERR_OK;                        /* OK */
}


/*
** ===================================================================
**     Method      :  RestoreSector (bean IntFLASH)
**
**     Description :
**         This method is internal. It is used by Processor Expert
**         only.
** ===================================================================
*/
static byte RestoreSector(dword Addr, word From, word To)
{
  byte err;
  word i;

  EnterCritical();                     /* Enter critical section */
  ClearFlags();                        /* Clear all flags */
  for (i = From; i < To; i=i+2)
  {
    *(volatile word *) (Addr+i) = PRam[i/2];
    FCMD = 32;                         /* Word program command */
    FSTAT = 128;                       /* Clear flag command buffer empty */
    asm {                              /* Jump to Wait in RAM code */
      CLRB
      JSR WaitInRAMcode
      STAB err
    }
    if (err) {
      ExitCritical();                  /* Exit critical section */
      return ERR_NOTAVAIL;             /* Return error code if previous operation finished not correctly */
    }
    if (*(volatile word *) (Addr+i) != PRam[i/2]) { /* Was attempt to write data to the given address errorneous? */
      ExitCritical();                  /* Exit critical section */
      return ERR_VALUE;                /* If yes then error */
    }
  }
  ExitCritical();                      /* Exit critical section */
  return ERR_OK;                       /* OK */
}

/*
** ===================================================================
**     Method      :  EraseSectorInternal (bean IntFLASH)
**
**     Description :
**         This method is internal. It is used by Processor Expert
**         only.
** ===================================================================
*/
byte EraseSectorInternal(dword Addr)
{
  byte err;

  EnterCritical();                     /* Enter critical section */
  ClearFlags();                        /* Clear all flags */
  if (FSTAT_CBEIF == 0) {              /* Is command buffer full ? */
    ExitCritical();                    /* Exit critical section */
    return ERR_BUSY;                   /* If yes then error */
  }
  *(volatile word *) (Addr&65535) = IFsh10_DummyData; /* Write eny word to FLASH buffer */
  FCMD = 64;                           /* Initiate Sector Erase commamd */
  FSTAT = 128;                         /* Clear flag command buffer empty */
  asm {                                /* Jump to Wait in RAM code */
    CLRB
    JSR WaitInRAMcode
    STAB err
  }
  ExitCritical();                      /* Exit critical section */
  if (err)
    return err;                        /* Return error code if previous operation finished not correctly */
  return ERR_OK;                       /* OK */

}

/*
** ===================================================================
**     Method      :  IFsh10_SetWordFlash (bean IntFLASH)
**
**     Description :
**         Write word to address in FLASH.
**     Parameters  :
**         NAME            - DESCRIPTION
**         Addr            - Address to FLASH.
**         Data            - Data to write.
**     Returns     :
**         ---             - Error code, possible codes:
**                           - ERR_OK - OK
**                           - ERR_NOTAVAIL - Desired program/erase
**                           operation is not available
**                           - ERR_RANGE - Address is out of range
**                           - ERR_VALUE - Read value is not equal to
**                           written value
**                           - ERR_SPEED - This device does not work
**                           in the active speed mode
**                           - ERR_BUSY - Device is busy
** ===================================================================
*/
byte IFsh10_SetWordFlash(dword Addr,word Data)
{
  byte err;

   if (Addr & 1)                        /* Aligned address ? */
    return ERR_NOTAVAIL;
   if (FSTAT_CCIF == 0)                 /* Is previous command complete ? */
    return ERR_BUSY;                   /* If yes then error */
  //if (*(volatile word*)(Addr&65535) != 65535) { /* Word in Flash not erased ? */
  //  BackupSector(Addr & 65024, 0, 512); /* Backup sector */
    err=EraseSectorInternal(Addr);     /* Erase sector */
    if(err)
      return(err);                     /* Return error code if previous operation finished not correctly */
 //   BackupArray[(Addr % 512) / 2] = Data; /* Write new data to saved sector */
    err = RestoreSector(Addr , 0, (Parametros+1)*2); /* Restore sector */
    if (err)
      return err;                      /* Previous operation was error ? */
 // }
 // else {
 //   err = WriteWord(Addr, Data);       /* Write new data to Flash */
 //   return(err);                       /* Return error */
//  }
}



/*
** ===================================================================
**     Method      :  IFsh10_Init (bean IntFLASH)
**
**     Description :
**         This method is internal. It is used by Processor Expert
**         only.
** ===================================================================
*/
void IFsh10_Init(void)
{
  FCLKDIV = 40;                        /* Set up Clock Divider Register */
}


/* END IFsh10. */


/*
** ###################################################################
**
**     This file was created by UNIS Processor Expert 2.95 [03.62]
**     for the Freescale HCS12 series of microcontrollers.
**
** ###################################################################
*/
