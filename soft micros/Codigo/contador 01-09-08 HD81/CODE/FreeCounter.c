/** ###################################################################
**     THIS BEAN MODULE IS GENERATED BY THE TOOL. DO NOT MODIFY IT.
**     Filename  : FreeCounter.C
**     Project   : contador_12_06_06
**     Processor : MC9S12GC16CFU16
**     Beantype  : FreeCntr32
**     Version   : Bean 02.033, Driver 01.06, CPU db: 2.87.320
**     Compiler  : Metrowerks HC12 C Compiler
**     Date/Time : 18/04/2008, 10:48 a.m.
**     Abstract  :
**         This device "FreeCntr32" implements 32-bit Free Running Counter
**     Settings  :
**         Timer name                  : TIM (16-bit)
**         Compare name                : TC1
**         Counter shared              : Yes
**
**         High speed mode
**             Prescaler               : divide-by-1
**             Clock                   : 25000000 Hz
**           Resolution of timer
**             Xtal ticks              : 800
**             microseconds            : 100
**             seconds (real)          : 0.0001000
**             Hz                      : 10000
**             kHz                     : 10
**
**         Initialization:
**              Timer                  : Enabled
**
**         Timer registers
**              Counter                : TCNT      [68]
**              Mode                   : TIOS      [64]
**              Run                    : TSCR1     [70]
**              Prescaler              : TSCR2     [77]
**
**         Compare registers
**              Compare                : TC1       [82]
**     Contents  :
**         Reset      - byte FreeCounter_Reset(void);
**         GetTimeSec - byte FreeCounter_GetTimeSec(word *Time);
**
**     (c) Copyright UNIS, spol. s r.o. 1997-2004
**     UNIS, spol. s r.o.
**     Jundrovska 33
**     624 00 Brno
**     Czech Republic
**     http      : www.processorexpert.com
**     mail      : info@processorexpert.com
** ###################################################################*/


/* MODULE FreeCounter. */

#include "FreeCounter.h"

#pragma DATA_SEG FreeCounter_DATA                                            
#pragma CODE_SEG FreeCounter_CODE                     

static dword TTicks;                   /* Counter of timer ticks */
static dword LTicks;                   /* Working copy of variable TTicks */
static bool TOvf;                      /* Counter overflow flag */
static bool LOvf;                      /* Working copy of variable TOvf */
static word CmpVal;                    /* Value periodicly addded to compare register */

/*
** ===================================================================
**     Method      :  SetCV (bean FreeCntr32)
**
**     Description :
**         This method is internal. It is used by Processor Expert
**         only.
** ===================================================================
*/
static void SetCV(word Val)
{
  TC1 = TCNT + Val;                    /* Store new value to the compare register */
  CmpVal = Val;                        /* and to the variable CmpVal */
}

/*
** ===================================================================
**     Method      :  LoadTicks (bean FreeCntr32)
**
**     Description :
**         This method is internal. It is used by Processor Expert
**         only.
** ===================================================================
*/
static void LoadTicks(void)
{
  EnterCritical();                     /* Save the PS register */
  LTicks = TTicks;                     /* Loading actual number of timer ticks */
  LOvf = TOvf;                         /* Loading actual state of "overflow flag" */
  ExitCritical();                      /* Restore the PS register */
}

/*
** ===================================================================
**     Method      :  FreeCounter_Reset (bean FreeCntr32)
**
**     Description :
**         Clears the counter.
**     Parameters  : None
**     Returns     :
**         ---       - Error Code
** ===================================================================
*/
byte FreeCounter_Reset(void)
{
  EnterCritical();                     /* Save the PS register */
  TC1 = TCNT + CmpVal;                 /* Store new value to compare register */
  TTicks =  0;                         /* Reset counter of timer ticks */
  TOvf = FALSE;                        /* Reset counter overflow flag */
  ExitCritical();                      /* Restore the PS register */
  return ERR_OK;                       /* OK */
}

/*
** ===================================================================
**     Method      :  FreeCounter_GetTimeSec (bean FreeCntr32)
**
**     Description :
**         Returns the time (as a 16-bit unsigned integer) in seconds
**         since the last resetting after the last reset.
**     Parameters  :
**         NAME            - DESCRIPTION
**       * Time            - A pointer to the returned 16-bit value
**                           in seconds
**     Returns     :
**         ---             - Error code, possible codes:
**                           ERR_OK - OK
**                           ERR_SPEED - This device does not work in
**                           the active speed mode
**                           ERR_OVERFLOW - Software counter overflow
**                           ERR_MATH - Overflow during evaluation
** ===================================================================
*/
byte FreeCounter_GetTimeSec(word *Time)
{
  dlong rtval;                         /* Result of two 32-bit numbers multiplication */

  LoadTicks();                         /* Load actual state of counter */
  if (LOvf)                            /* Testing counter overflow */
    return ERR_OVERFLOW;               /* If yes then error */
  PE_Timer_LngMul(LTicks,109951163,&rtval); /* Multiply ticks and high speed CPU mode coefficient */
  if (PE_Timer_LngHi5(rtval[0],rtval[1],Time)) /* Is the result greater or equal than 65536 ? */
    return ERR_MATH;                   /* If yes then error */
  else                                 /* Is the result less than 65536 ? */
    return ERR_OK;                     /* If yes then OK */
}

/*
** ===================================================================
**     Method      :  FreeCounter_Init (bean FreeCntr32)
**
**     Description :
**         This method is internal. It is used by Processor Expert
**         only.
** ===================================================================
*/
void FreeCounter_Init(void)
{
  TTicks = 0;                          /* Counter of timer ticks */
  TOvf = FALSE;                        /* Counter overflow flag */
  SetCV(2500);                         /* Store appropriate value to the compare register according to the selected high speed CPU mode */
  TFLG1 = 2;                           /* Reset interrupt request flag */
  TIE_C1I = 1;                         /* Enable interrupt */
}

/*
** ===================================================================
**     Method      :  FreeCounter_Interrupt (bean FreeCntr32)
**
**     Description :
**         This method is internal. It is used by Processor Expert
**         only.
** ===================================================================
*/
#pragma CODE_SEG __NEAR_SEG NON_BANKED     
ISR(FreeCounter_Interrupt)
{
  TC1 += CmpVal;                       /* Add value corresponding with periode */
  TTicks++;                            /* Increment counter of timer ticks */
  if (TTicks == 0)                     /* Testing counter overflow */
    TOvf = TRUE;                       /* If yes then set overflow flag */
  TFLG1 = 2;                           /* Reset interrupt request flag */
}

#pragma CODE_SEG FreeCounter_CODE                     

/* END FreeCounter. */

/*
** ###################################################################
**
**     This file was created by UNIS Processor Expert 2.95.01 [03.62]
**     for the Freescale HCS12 series of microcontrollers.
**
** ###################################################################
*/
