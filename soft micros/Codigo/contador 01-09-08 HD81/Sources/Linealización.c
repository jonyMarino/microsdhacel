/** ###################################################################
**     THIS BEAN MODULE IS GENERATED BY THE TOOL. DO NOT MODIFY IT.
**     Filename  : PtRh1.C
**     Project   : _22_11
**     Processor : MC9S12A32BCFU
**     Beantype  : PtRh
**     Version   : Bean 01.003, Driver 01.22, CPU db: 2.87.267
**     Compiler  : Metrowerks HC12 C Compiler
**     Date/Time : 23/11/2005, 12:40
**     Abstract  :
**         This bean "PtRh" implements Pt-Rh thermo element
**         correction.
**     Settings  :
**          Input value                : X  = 0
**          Thermopotential            : Tp = 0
**     Contents  :
**         Run - void PtRh1_Run(void);
**
**     (c) Copyright UNIS, spol. s r.o. 1997-2004
**     UNIS, spol. s r.o.
**     Jundrovska 33
**     624 00 Brno
**     Czech Republic
**     http      : www.processorexpert.com
**     mail      : info@processorexpert.com
** ###################################################################*/

/*IMPLEMENTATION MODULE PtRh1; */
#include "Mydefines.h"
#include "PE_Types.h"
#include "PE_Error.h"
////////Tablas de linealizaciСn/////////////////////
static const float FeKo_X[] = {0, 5.268, 10.777, 16.325, 21.846, 27.388, 33.096, 39.130, 42.283};
static const float FeKo_Y[] = {0, 100, 200, 300, 400, 500, 600, 700, 750};
static const float NiCr_X[] = {0.0,4.095,8.137,12.207,16.395,20.640,24.902,29.128,33.277,37.325,41.269};
static const float NiCr_Y[] = {0, 100, 200, 300, 400, 500, 600, 700, 800, 900, 1000};
static const float PtRh_X[] = {0.0, 0.645, 1.440, 2.323, 3.260, 4.234, 5.237, 6.274, 7.345, 8.448, 9.585, 10.754, 11.947, 13.155};
static const float PtRh_Y[] = {0,     100,   200,   300,   400,   500,   600,   700,   800,   900,  1000,   1100,   1200,   1300};
/////////////////////////////////////////////////////

/*
** ===================================================================
**     Method      :  Linealizar 
**
**     Description :
**         Run the method. The thermopotential - temperature function
**         is defined by a pair of coordinates accordingly to DIN
**         43710 respectively IEC - 584 - 1 ( Type S ).
**     Parameters  : Vx, sensor
**     Returns     : Vy
** ===================================================================
*/
byte Linealizar(float Vx, byte sensor, float * Vy)
{
  int r;
  float * xdat, * ydat;
  
  switch (sensor){
    case 0:
          xdat=FeKo_X;
          ydat=FeKo_Y;
          r=8;
          break;
    case 1:
          xdat=NiCr_X;
          ydat=NiCr_Y;
          r=10;
          break;
    case 2:
    			xdat=PtRh_X;
          ydat=NiCr_Y;
          r=13;
          break;
    
  }
  
  
  if (Vx <= xdat[0]) {
    * Vy = ydat[0];
    if (Vx < xdat[0])
      return ERR_UF;
     }
   else if (Vx > xdat[13]) {
     * Vy = ydat[13];
     return ERR_OF;
   }
   else {						 
     int l = 0, i = 0, eq = 0;

     while ((l < r) && (r - l > 1)) {
       i = (l + r) / 2;
       if (Vx > xdat[i])
         l = i;
       else
         if (Vx < xdat[i])
           r = i;
         else {
           eq = 1;
           break;
         }
     }
     if (eq)
       * Vy = ydat[i];
     else * Vy = ydat[l] + ((Vx - xdat[l]) / (xdat[r] - xdat[l])) * (ydat[r] - ydat[l]);
   }
return ERR_OK;
}

/* END PtRh1. */

/*
** ###################################################################
**
**     This file was created by UNIS Processor Expert 2.95 [03.62]
**     for the Freescale HCS12 series of microcontrollers.
**
** ###################################################################
*/
