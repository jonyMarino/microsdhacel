/** ###################################################################
**     THIS BEAN MODULE IS GENERATED BY THE TOOL. DO NOT MODIFY IT.
**     Filename  : TO2.C
**     Project   : _10_03
**     Processor : MC9S12GC32CFU16
**     Beantype  : TimerOut
**     Version   : Bean 02.095, Driver 01.08, CPU db: 2.87.320
**     Compiler  : Metrowerks HC12 C Compiler
**     Date/Time : 14/07/2006, 14:11
**     Abstract  :
**         This bean implements a periodic signal generator 1:1 (Flip-Flop Output).
**         The signal alternates the "0" and "1" output values in exactly
**         regular intervals; that is why the time length of the "0" part
**         of one pulse is equal to the "1" part of one pulse.
**     Settings  :
**         Used output pin             : 
**             ----------------------------------------------------
**                Number (on package)  |    Name
**             ----------------------------------------------------
**                       11            |  PT4_PWM4_IOC4
**             ----------------------------------------------------
**
**         Timer name                  : TIM (16-bit)
**         Compare name                : TC4
**           Counter shared            : Yes
**
**         High speed mode
**             Prescaler               : divide-by-4
**             Clock                   : 6250000 Hz
**           Pulse width
**             Xtal ticks              : 32
**             microseconds            : 4
**             seconds (real)          : 0.0000040
**             Hz                      : 250000
**             kHz                     : 250
**
**         Runtime setting             : pulse width interval (continual setting)
**             ticks                   : 32 to 80000 ticks
**             microseconds            : 4 to 10000 microseconds
**             milliseconds            : 1 to 10 milliseconds
**             seconds (real)          : 0.0000040 to 0.0100000 seconds
**             Hz                      : 100 to 250000 Hz
**             kHz                     : 1 to 250 kHz
**
**         Initialization:
**              Output level           : low
**              Timer                  : Enabled
**              Events                 : Enabled
**
**         Timer registers
**              Counter                : TCNT      [68]
**              Mode                   : TIOS      [64]
**              Run                    : TSCR1     [70]
**              Prescaler              : TSCR2     [77]
**
**         Compare registers
**              Compare                : TC4       [88]
**
**         Flip-flop registers
**              Mode                   : TCTL1     [72]
**     Contents  :
**         Enable      - byte TO2_Enable(void);
**         Disable     - byte TO2_Disable(void);
**         SetPeriodUS - byte TO2_SetPeriodUS(word Time);
**         SetValue    - byte TO2_SetValue(void);
**         ClrValue    - byte TO2_ClrValue(void);
**
**     (c) Copyright UNIS, spol. s r.o. 1997-2004
**     UNIS, spol. s r.o.
**     Jundrovska 33
**     624 00 Brno
**     Czech Republic
**     http      : www.processorexpert.com
**     mail      : info@processorexpert.com
** ###################################################################*/


/* MODULE TO2. */

#include "Events.h"
#include "PE_Error.h"
#include "TO2.h"

#pragma DATA_SEG TO2_DATA                                            
#pragma CODE_SEG TO2_CODE                     
static bool Internal_Value;
static bool EnUser;                    /* Enable/Disable device by user */
static word CmpVal;                    /* Value periodicly addded to compare register */
static word CmpHighVal;                /* Compare register value for high speed mode */


/*
** ===================================================================
**     Method      :  SetCV (bean TimerOut)
**
**     Description :
**         This method is internal. It is used by Processor Expert
**         only.
** ===================================================================
*/
static void SetCV(word Val)
{
  TC4 = TCNT + Val;                    /* Store new value to the compare register */
  CmpVal = Val;                        /* and to the variable CmpVal */
}

/*
** ===================================================================
**     Method      :  HWEnDi (bean TimerOut)
**
**     Description :
**         This method is internal. It is used by Processor Expert
**         only.
** ===================================================================
*/
static void HWEnDi(void)
{
  if (EnUser) {                        /* Enable device? */
    TC4 = TCNT + CmpVal;               /* Store new value to the compare register */
    TFLG1 = 16;                        /* Reset interrupt request flag */
    TIE_C4I = 1;                       /* Enable interrupt */
    TCTL1_OL4 = 1;                     /* Connect timer to output line */
  }
  else {                               /* Disable device? */
    TCTL1_OL4 = 0;                     /* Disconnect timer from output */
    TIE_C4I = 0;                       /* Disable interrupt */
  }
}

/*
** ===================================================================
**     Method      :  TO2_Enable (bean TimerOut)
**
**     Description :
**         Enables the bean - it starts the signal generation. Events
**         may be generated ("DisableEvent"/"EnableEvent").
**     Parameters  : None
**     Returns     :
**         ---             - Error code, possible codes:
**                           ERR_OK - OK
**                           ERR_SPEED - This device does not work in
**                           the active speed mode
** ===================================================================
*/
byte TO2_Enable(void)
{
  if (!EnUser) {                       /* Is the device disabled by user? */
    EnUser = TRUE;                     /* If yes then set the flag "device enabled" */
    HWEnDi();                          /* Enable the device */
  }
  return ERR_OK;                       /* OK */
}

/*
** ===================================================================
**     Method      :  TO2_Disable (bean TimerOut)
**
**     Description :
**         Disables the timer - it stops signal generation and events
**         calling. When the timer is disabled, it is possible to
**         call methods "ClrValue" and "SetValue".
**     Parameters  : None
**     Returns     :
**         ---             - Error code, possible codes:
**                           ERR_OK - OK
**                           ERR_SPEED - This device does not work in
**                           the active speed mode
** ===================================================================
*/
byte TO2_Disable(void)
{
  if (EnUser) {                        /* Is the device enabled by user? */
    EnUser = FALSE;                    /* If yes then set the flag "device disabled" */
    HWEnDi();                          /* Disable the device */
  }
  return ERR_OK;                       /* OK */
}

/*
** ===================================================================
**     Method      :  TO2_SetPeriodUS (bean TimerOut)
**
**     Description :
**         This method sets the new period of the output signal. The
**         period is expressed in microseconds as a 16-bit unsigned
**         integer number.
**         This method is available only if the runtime setting type
**         'from interval' is selected in the Timing dialog box in
**         the Runtime setting area.
**     Parameters  :
**         NAME            - DESCRIPTION
**         Time            - Period to set [in microseconds]
**                      (4 to 10000 microseconds)
**     Returns     :
**         ---             - Error code, possible codes:
**                           ERR_OK - OK
**                           ERR_SPEED - This device does not work in
**                           the active speed mode
**                           ERR_MATH - Overflow during evaluation
**                           ERR_RANGE - Parameter out of range
** ===================================================================
*/
byte TO2_SetPeriodUS(word Time)
{
  dlong rtval;                         /* Result of two 32-bit numbers multiplication */
  word rtword;                         /* Result of 64-bit number division */

  if ((Time > 10000) || (Time < 4))    /* Is the given value out of range? */
    return ERR_RANGE;                  /* If yes then error */
  PE_Timer_LngMul((dword)Time,104857600,&rtval); /* Multiple given value and high speed mode coefficient */
  if (PE_Timer_LngHi3(rtval[0],rtval[1],&rtword)) /* Is the result greater or equal than 65536 ? */
    rtword = 65535;                    /* If yes then use maximal possible value */
  CmpHighVal = rtword;                 /* Store result (compare register value for high speed mode) to the variable CmpHighVal */
  SetCV(CmpHighVal);                   /* Store appropriate value to the compare register according to the selected high speed mode */
  return ERR_OK;                       /* OK */
}

/*
** ===================================================================
**     Method      :  TO2_SetValue (bean TimerOut)
**
**     Description :
**         This method sets (sets to "1" = "High") timer flip-flop
**         output signal level. It allow user to directly set the
**         output pin value (=flip-flop state), and can set the
**         signal polarity. This method works only when the timer is
**         disabled (Disable) otherwise it returns the error code.
**     Parameters  : None
**     Returns     :
**         ---             - Error code, possible codes:
**                           ERR_OK - OK
**                           ERR_SPEED - This device does not work in
**                           the active speed mode
**                           ERR_ENABLED - Bean is enabled. Bean must
**                           be disabled (see <a
**                           href="TimerOutMethods.html">Disable
**                           method</a> method)
** ===================================================================
*/
byte TO2_SetValue(void)
{
  if (EnUser)                          /* Is the device enabled by user? */
    return ERR_ENABLED;                /* If yes then error */
  PTT_PTT4 = 1;                        /* Set output signal level to high */
  return ERR_OK;                       /* OK */
}

/*
** ===================================================================
**     Method      :  TO2_ClrValue (bean TimerOut)
**
**     Description :
**         This method clears (sets to "0" = "Low") timer flip-flop
**         output signal level. It allow user to directly set the
**         output pin value (=flip-flop state), and can set the
**         signal polarity. This method works only when the timer is
**         disabled (Disable) otherwise it returns the error code.
**     Parameters  : None
**     Returns     :
**         ---             - Error code, possible codes:
**                           ERR_OK - OK
**                           ERR_SPEED - This device does not work in
**                           the active speed mode
**                           ERR_ENABLED - Bean is enabled. Bean must
**                           be disabled (see <a
**                           href="TimerOutMethods.html">Disable</a>
**                           method)
** ===================================================================
*/
byte TO2_ClrValue(void)
{
  if (EnUser)                          /* Is the device enabled by user? */
    return ERR_ENABLED;                /* If yes then error */
  PTT_PTT4 = 0;                        /* Set output signal level to low */
  return ERR_OK;                       /* OK */
}

/*
** ===================================================================
**     Method      :  TO2_Init (bean TimerOut)
**
**     Description :
**         This method is internal. It is used by Processor Expert
**         only.
** ===================================================================
*/
void TO2_Init(void)
{
  Internal_Value = 0;
  CmpHighVal = 25;                     /* Compare register value for high speed mode */
  EnUser = TRUE;                       /* Enable device */
  SetCV(CmpHighVal);                   /* Store appropriate value to the compare register */
  HWEnDi();                            /* Enable/disable device according to status flags */
}

/*
** ===================================================================
**     Method      :  TO2_Interrupt (bean TimerOut)
**
**     Description :
**         This method is internal. It is used by Processor Expert
**         only.
** ===================================================================
*/
#pragma CODE_SEG __NEAR_SEG NON_BANKED     
ISR(TO2_Interrupt)
{
  Internal_Value = !Internal_Value;
  TC4 += CmpVal;                       /* Add value corresponding with periode */
  TFLG1 = 16;                          /* Reset interrupt request flag */
  if (Internal_Value == 0) {           /* Is the pin output level low? */
    TO2_OnFalling();                   /* Invoke user event */
  }
}

#pragma CODE_SEG TO2_CODE                     

/* END TO2. */

/*
** ###################################################################
**
**     This file was created by UNIS Processor Expert 2.95 [03.62]
**     for the Freescale HCS12 series of microcontrollers.
**
** ###################################################################
*/
