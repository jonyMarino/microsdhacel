/** ###################################################################
**     THIS BEAN MODULE IS GENERATED BY THE TOOL. DO NOT MODIFY IT.
**     Filename  : AS1.C
**     Project   : contador_12_06_06
**     Processor : MC9S12GC32CFU16
**     Beantype  : AsynchroSerial
**     Version   : Bean 02.433, Driver 01.17, CPU db: 2.87.392
**     Compiler  : CodeWarrior HC12 C Compiler
**     Date/Time : 06/05/2009, 9:16
**     Abstract  :
**         This bean "AsynchroSerial" implements an asynchronous serial
**         communication. The bean supports different settings of
**         parity, word width, stop-bit and communication speed,
**         user can select interrupt or polling handler.
**         Communication speed can be changed also in runtime.
**         The bean requires one on-chip asynchronous serial channel.
**     Settings  :
**         Serial channel              : SCI
**
**         Protocol
**             Init baud rate          : 9600baud
**             Width                   : 8 bits
**             Stop bits               : 1
**             Parity                  : none
**             Breaks                  : Disabled
**
**         Registers
**             Input buffer            : SCIDRL    [207]
**             Output buffer           : SCIDRL    [207]
**             Control register        : SCICR1    [202]
**             Mode register           : SCICR2    [203]
**             Baud setting reg.       : SCIBD     [200]
**             Special register        : SCISR1    [204]
**
**
**
**         Used pins:
**         ----------------------------------------------------------
**           Function | On package           |    Name
**         ----------------------------------------------------------
**            Input   |     63               |  PS0_RxD
**            Output  |     64               |  PS1_TxD
**         ----------------------------------------------------------
**
**
**
**     Contents  :
**         RecvChar      - byte AS1_RecvChar(AS1_TComData *Chr);
**         SendChar      - byte AS1_SendChar(AS1_TComData Chr);
**         GetTxComplete - bool AS1_GetTxComplete(void);
**
**     (c) Copyright UNIS, spol. s r.o. 1997-2007
**     UNIS, spol. s r.o.
**     Jundrovska 33
**     624 00 Brno
**     Czech Republic
**     http      : www.processorexpert.com
**     mail      : info@processorexpert.com
** ###################################################################*/

/* MODULE AS1. */

#pragma MESSAGE DISABLE C4002 /* WARNING C4002: Result not used is ignored */
#pragma MESSAGE DISABLE C4301 /* INFORMATION C4301: Inline expansion done for function call */

#include "AS1.h"
#include "Display1.h"
#include "Display2.h"
#include "DL2.h"
#include "bits5ULN.h"
#include "vx1.h"
#include "vx2.h"
#include "trx.h"
#include "PTSL.h"
#include "PWSN.h"
#include "PUL.h"
#include "FLASH1.h"
#include "TI2.h"
#include "TI1.h"
#include "Rele1.h"
#include "Rele2.h"
#include "Reset.h"
#include "PP4.h"
#include "PP3.h"
#include "FreeCounter.h"

#pragma DATA_SEG AS1_DATA
#pragma CODE_SEG AS1_CODE




/*
** ===================================================================
**     Method      :  AS1_RecvChar (bean AsynchroSerial)
**
**     Description :
**         If any data is received, this method returns one
**         character, otherwise it returns an error code (it does
**         not wait for data). This method is enabled only if the
**         receiver property is enabled.
**         [Note:] Because the preferred method to handle error and
**         break exception in the interrupt mode is to use events
**         <OnError> and <OnBreak> the return value ERR_RXEMPTY has
**         higher priority than other error codes. As a consequence
**         the information about an exception in interrupt mode is
**         returned only if there is a valid character ready to be
**         read.
**     Parameters  :
**         NAME            - DESCRIPTION
**       * Chr             - Pointer to a received character
**     Returns     :
**         ---             - Error code, possible codes:
**                           ERR_OK - OK
**                           ERR_SPEED - This device does not work in
**                           the active speed mode
**                           ERR_RXEMPTY - No data in receiver
**                           ERR_BREAK - Break character is detected
**                           (only when the <Interrupt service>
**                           property is disabled and the <Break
**                           signal> property is enabled)
**                           ERR_COMMON - common error occurred (the
**                           <GetError> method can be used for error
**                           specification)
** ===================================================================
*/
byte AS1_RecvChar(AS1_TComData *Chr)
{
  byte Result = ERR_OK;                /* Return error code */
  byte StatReg = SCISR1;               /* Read status register */

  if (StatReg & (SCISR1_OR_MASK|SCISR1_NF_MASK|SCISR1_FE_MASK|SCISR1_PF_MASK)) { /* Is any error flag set? */
    Result = ERR_COMMON;               /* If yes then set common error value */
  } else if (!(StatReg & SCISR1_RDRF_MASK)) { /* Is the reciver empty and no error is set? */
    return ERR_RXEMPTY;                /* If yes then error */
  }
  *Chr = SCIDRL;                       /* Read data from the receiver */
  return Result;                       /* Return error code */
}

/*
** ===================================================================
**     Method      :  AS1_SendChar (bean AsynchroSerial)
**
**     Description :
**         Sends one character to the channel. If the bean is
**         temporarily disabled (Disable method) SendChar method
**         only stores data into an output buffer. In case of a zero
**         output buffer size, only one character can be stored.
**         Enabling the bean (Enable method) starts the transmission
**         of the stored data. This method is available only if the
**         transmitter property is enabled.
**     Parameters  :
**         NAME            - DESCRIPTION
**         Chr             - Character to send
**     Returns     :
**         ---             - Error code, possible codes:
**                           ERR_OK - OK
**                           ERR_SPEED - This device does not work in
**                           the active speed mode
**                           ERR_TXFULL - Transmitter is full
** ===================================================================
*/
byte AS1_SendChar(AS1_TComData Chr)
{
  if(!SCISR1_TDRE) {                   /* Is the transmitter empty? */
    return ERR_TXFULL;                 /* If no then error */
  }
  SCIDRL = (byte)Chr;
  return ERR_OK;                       /* OK */
}

/*
** ===================================================================
**     Method      :  AS1_Init (bean AsynchroSerial)
**
**     Description :
**         Initializes the associated peripheral(s) and internal 
**         variables of the bean. The method is called automatically as a 
**         part of the application initialization code.
**         This method is internal. It is used by Processor Expert only.
** ===================================================================
*/
void AS1_Init(void)
{
  /* SCICR1: LOOPS=0,SCISWAI=0,RSRC=0,M=0,WAKE=0,ILT=0,PE=0,PT=0 */
  setReg8(SCICR1, 0);                   
  /* SCISR2: ??=0,??=0,??=0,??=0,??=0,BRK13=0,TXDIR=0,RAF=0 */
  setReg8(SCISR2, 0);                   
  (void) SCISR1;                       /* Reset interrupt request flags */
  /* SCICR2: SCTIE=0,TCIE=0,RIE=0,ILIE=0,TE=0,RE=0,RWU=0,SBK=0 */
  SCICR2 = 0;                          /* Disable error interrupts */
  SCIBD = 52;                          /* Set prescaler bits */
  SCICR2 |= (SCICR2_TE_MASK | SCICR2_RE_MASK); /* Enable transmitter, Enable receiver */
}

/*
** ===================================================================
**     Method      :  AS1_GetTxComplete (bean AsynchroSerial)
**
**     Description :
**         Returns whether the transmitter is finished transmitting
**         all data, preamble, and break characters and is idle. It
**         can be used to determine when it is safe to switch a line
**         driver (e.g. in RS-485 applications). This method is
**         available only if event <OnTxComplete> is disabled.
**     Parameters  : None
**     Returns     :
**         ---             - Transmission process completeness.
** ===================================================================
*/
/*
bool AS1_GetTxComplete(void)

**      This method is implemented as a macro. See header module. **
*/



/* END AS1. */


/*
** ###################################################################
**
**     This file was created by UNIS Processor Expert 2.98 [03.98]
**     for the Freescale HCS12 series of microcontrollers.
**
** ###################################################################
*/
