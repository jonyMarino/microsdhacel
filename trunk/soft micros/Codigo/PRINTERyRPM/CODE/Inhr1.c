/** ###################################################################
**     THIS BEAN MODULE IS GENERATED BY THE TOOL. DO NOT MODIFY IT.
**     Filename  : Inhr1.C
**     Project   : Project_2
**     Processor : MC9S12GC32CFU16
**     Beantype  : BitIO
**     Version   : Bean 02.068, Driver 03.09, CPU db: 2.87.392
**     Compiler  : CodeWarrior HC12 C Compiler
**     Date/Time : 5/4/2009, 5:32 PM
**     Abstract  :
**         This bean "BitIO" implements an one-bit input/output.
**         It uses one bit/pin of a port.
**         Note: This bean is not set in the "Safe mode". See help.
**         Methods of this bean are mostly implemented as a macros
**         (if supported by target language and compiler).
**     Settings  :
**         Used pin                    :
**             ----------------------------------------------------
**                Number (on package)  |    Name
**             ----------------------------------------------------
**                       (79            |  PP5_PWM5_KWP5 (antes))
**                         51            |  PAD00_AN00
**             ----------------------------------------------------
**
**         Port name                   : P
**
**         Bit number (in port)        : 5
**         Bit mask of the port        : 32
**
**         Initial direction           : Input (direction can be changed)
**         Safe mode                   : no
**         Initial output value        : 1
**         Initial pull option         : up
**
**         Port data register          : PTP       [600]
**         Port control register       : DDRP      [602]
**
**         Optimization for            : speed
**     Contents  :
**         SetDir - void Inhr1_SetDir(bool Dir);
**         GetVal - bool Inhr1_GetVal(void);
**         PutVal - void Inhr1_PutVal(bool Val);
**         ClrVal - void Inhr1_ClrVal(void);
**         SetVal - void Inhr1_SetVal(void);
**         NegVal - void Inhr1_NegVal(void);
**
**     (c) Copyright UNIS, spol. s r.o. 1997-2007
**     UNIS, spol. s r.o.
**     Jundrovska 33
**     624 00 Brno
**     Czech Republic
**     http      : www.processorexpert.com
**     mail      : info@processorexpert.com
** ###################################################################*/

/* MODULE Inhr1. */

#include "Inhr1.h"
  /* Including shared modules, which are used in the whole project */
#include "PE_Types.h"
#include "PE_Error.h"
#include "PE_Const.h"
#include "IO_Map.h"
#include "Cpu.h"

#pragma DATA_SEG Inhr1_DATA
#pragma CODE_SEG Inhr1_CODE
#pragma CONST_SEG Inhr1_CONST          /* Constant section for this module */
/*
** ===================================================================
**     Method      :  Inhr1_GetVal (bean BitIO)
**
**     Description :
**         This method returns an input value.
**           a) direction = Input  : reads the input value from the
**                                   pin and returns it
**           b) direction = Output : returns the last written value
**     Parameters  : None
**     Returns     :
**         ---             - Input value. Possible values:
**                           FALSE - logical "0" (Low level)
**                           TRUE - logical "1" (High level)

** ===================================================================
*/
/*
bool Inhr1_GetVal(void)

**  This method is implemented as a macro. See Inhr1.h file.  **
*/

/*
** ===================================================================
**     Method      :  Inhr1_PutVal (bean BitIO)
**
**     Description :
**         This method writes the new output value.
**         Note: If direction is set to input the method code may not
**               work properly.
**     Parameters  :
**         NAME       - DESCRIPTION
**         Val             - Output value. Possible values:
**                           FALSE - logical "0" (Low level)
**                           TRUE - logical "1" (High level)
**     Returns     : Nothing
** ===================================================================
*/
#ifdef opcion_1

void Inhr1_PutVal(bool Val)
{
  if (Val) {
    setReg8Bits(PTP, 32);              /* PTP5=1 */
  } else { /* !Val */
    clrReg8Bits(PTP, 32);              /* PTP5=0 */
  } /* !Val */
}
  
#else  
  void Inhr1_PutVal(bool Val)
{
  if (Val) {
    setReg8Bits(PTAD, 1);              /* PTAD0=1 */
  } else { /* !Val */
    clrReg8Bits(PTAD, 1);              /* PTAD0=0 */
  } /* !Val */
}
#endif  
/*
** ===================================================================
**     Method      :  Inhr1_ClrVal (bean BitIO)
**
**     Description :
**         This method clears (sets to zero) the output value.
**         Note: If direction is set to input the method code may not
**               work properly.
**     Parameters  : None
**     Returns     : Nothing
** ===================================================================
*/
/*
void Inhr1_ClrVal(void)

**  This method is implemented as a macro. See Inhr1.h file.  **
*/

/*
** ===================================================================
**     Method      :  Inhr1_SetVal (bean BitIO)
**
**     Description :
**         This method sets (sets to one) the output value.
**         Note: If direction is set to input the method code may not
**               work properly.
**     Parameters  : None
**     Returns     : Nothing
** ===================================================================
*/
/*
void Inhr1_SetVal(void)

**  This method is implemented as a macro. See Inhr1.h file.  **
*/

/*
** ===================================================================
**     Method      :  Inhr1_NegVal (bean BitIO)
**
**     Description :
**         This method negates (inverts) the output value.
**         Note: If direction is set to input the method code may not
**               work properly.
**     Parameters  : None
**     Returns     : Nothing
** ===================================================================
*/
/*
void Inhr1_NegVal(void)

**  This method is implemented as a macro. See Inhr1.h file.  **
*/

/*
** ===================================================================
**     Method      :  Inhr1_SetDir (bean BitIO)
**
**     Description :
**         This method sets direction of the bean.
**     Parameters  :
**         NAME       - DESCRIPTION
**         Dir        - Direction to set (FALSE or TRUE)
**                      FALSE = Input, TRUE = Output
**     Returns     : Nothing
** ===================================================================
*/
#ifdef opcion_1
void Inhr1_SetDir(bool Dir)
{
  if (Dir) {
    setReg8Bits(DDRP, 32);             /* DDRP5=1 */
  } else { /* !Dir */
    clrReg8Bits(DDRP, 32);             /* DDRP5=0 */
  } /* !Dir */
}
 
#else
void Inhr1_SetDir(bool Dir)
{
  if (Dir) {
    setReg8Bits(DDRAD, 1);             /* DDRAD0=1 */
  } else { /* !Dir */
    clrReg8Bits(DDRAD, 1);             /* DDRAD0=0 */
  } /* !Dir */
}
#endif
/* END Inhr1. */
/*
** ###################################################################
**
**     This file was created by UNIS Processor Expert 2.98 [03.98]
**     for the Freescale HCS12 series of microcontrollers.
**
** ###################################################################
*/
